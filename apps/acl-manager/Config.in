## apps/acl-manager/Config.in
```kconfig
config PACKAGE_acl-manager
    tristate
    select SAH_SERVICES_ACL-MANAGER

if PACKAGE_acl-manager

menu "Select acl-manager build options"
    depends on PACKAGE_acl-manager

config SAH_SERVICES_ACL-MANAGER
    bool "The ACL manager will monitor the ACL directory and merge ACL files together to create a single master ACL file per role."
    default y

config SAH_SERVICES_ACL-MANAGER_START_ORDER
    int "Start up order for the acl-manager plugin"
    default 16

config SAH_SERVICES_ACL-MANAGER_STOP_ORDER
    int "Shutdown order for the acl-manager plugin"
    default 84

config SAH_SERVICES_ACL-MANAGER_REQUIRES_USERS
    bool "Add a dependency on Users.Group.acl-group that is required on prpl OS"
    default y

config SAH_SERVICES_ACL-MANAGER_RUN_AS_USER
    string "User will be used for the acl-manager plugin"
    default "tr181_app"

config SAH_SERVICES_ACL-MANAGER_RUN_AS_GROUP
    string "Group will be used for the acl-manager plugin"
    default "acl"

endmenu

endif
```

## apps/amxb-inspect/Config.in
```kconfig
config PACKAGE_amxb-inspect
    tristate
    select SAH_SERVICES_AMXB_INSPECT

if PACKAGE_amxb-inspect

menu "Select amxb-inspect build options"
    depends on PACKAGE_amxb-inspect

config SAH_SERVICES_AMXB_INSPECT
    bool "Build amxb-inspect application"
    default y

endmenu

endif
```

## apps/amxo-cg/Config.in
```kconfig
config PACKAGE_amxo-cg
    tristate
    select SAH_SERVICES_AMXO_CG

if PACKAGE_amxo-cg

menu "Select amxo-cg build options"
    depends on PACKAGE_amxo-cg

config SAH_SERVICES_AMXO_CG
    bool "Build amxo-cg application"
    default y

endmenu

endif
```

## libs/libamxb/Config.in
```kconfig
config PACKAGE_libamxb
    tristate
    select SAH_LIB_AMXB

if PACKAGE_libamxb

menu "Select libamxb build options"
    depends on PACKAGE_libamxb

config SAH_LIB_AMXB
    bool "Build libamxb"
    default y

endmenu

endif
```

## libs/libamxc/Config.in
```kconfig
config PACKAGE_libamxc
    tristate
    select SAH_LIB_AMXC

if PACKAGE_libamxc

menu "Select libamxc build options"
    depends on PACKAGE_libamxc

config SAH_LIB_AMXC
    bool "Build libamxc"
    default y

endmenu

endif
```

## libs/libamxd/Config.in
```kconfig
config PACKAGE_libamxd
    tristate
    select SAH_LIB_AMXD

if PACKAGE_libamxd

menu "Select libamxd build options"
    depends on PACKAGE_libamxd

config SAH_LIB_AMXD
    bool "Build libamxd"
    default y

endmenu

endif
```

## libs/libamxj/Config.in
```kconfig
config PACKAGE_libamxj
    tristate
    select SAH_LIB_AMXJ

if PACKAGE_libamxj

menu "Select libamxj build options"
    depends on PACKAGE_libamxj

config SAH_LIB_AMXJ
    bool "Build libamxj"
    default y

endmenu

endif
```

## libs/libamxm/Config.in
```kconfig
config PACKAGE_libamxm
    tristate
    select SAH_LIB_AMXP

if PACKAGE_libamxm

menu "Select libamxm build options"
    depends on PACKAGE_libamxm

config SAH_LIB_AMXP
    bool "Build libamxm"
    default y

endmenu

endif
```

## libs/libamxo/Config.in
```kconfig
config PACKAGE_libamxo
    tristate
    select SAH_LIB_AMXO

if PACKAGE_libamxo

menu "Select libamxo build options"
    depends on PACKAGE_libamxo

config SAH_LIB_AMXO
    bool "Build libamxo"
    default y

endmenu

endif
```

## libs/libamxp/Config.in
```kconfig
config PACKAGE_libamxp
    tristate
    select SAH_LIB_AMXP

if PACKAGE_libamxp

menu "Select libamxp build options"
    depends on PACKAGE_libamxp

config SAH_LIB_AMXP
    bool "Build libamxp"
    default y

endmenu

endif
```

## libs/libamxt/Config.in
```kconfig
config PACKAGE_libamxt
    tristate
    select SAH_LIB_AMXP

if PACKAGE_libamxt

menu "Select libamxt build options"
    depends on PACKAGE_libamxt

config SAH_LIB_AMXP
    bool "Build libamxt"
    default y

endmenu

endif
```

## mods/mod-sahtrace/Config.in
```kconfig
config PACKAGE_mod-sahtrace
    tristate
    select SAH_MOD_SAHTRACE

if PACKAGE_mod-sahtrace

menu "Select mod-sahtrace build options"
    depends on PACKAGE_mod-sahtrace

config SAH_MOD_SAHTRACE
    bool "Build Ambiorix sahtrace module"
    default y

endmenu

endif
```
